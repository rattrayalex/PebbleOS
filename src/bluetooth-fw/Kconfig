## src/bluetooth-fw/Kconfig
```kconfig
# SPDX-FileCopyrightText: 2026 Core Devices LLC
# SPDX-License-Identifier: Apache-2.0

menu "Bluetooth"

choice BT_FW
    prompt "Bluetooth backend"
    default BT_FW_STUB
    help
      Which Bluetooth backend implementation to build. The default is
      derived from the SoC (see each soc/<soc>/Kconfig.defconfig);
      the stub is the fallback when no SoC default applies.

config BT_FW_NIMBLE
    bool "NimBLE"
    select MBEDTLS
    select HAL_SIFLI_IPC_QUEUE if SOC_SF32LB52
    select HAL_SIFLI_LCPU if SOC_SF32LB52

config BT_FW_QEMU
    bool "QEMU transport"

config BT_FW_STUB
    bool "Stub (no backend)"

endchoice

module = BT
module-str = Bluetooth
source "subsys/logging/Kconfig.template.log_level"

config BT_KEYBOARD
    bool "BLE keyboard navigation (experimental)"
    depends on BT_FW_NIMBLE && !RECOVERY_FW
    default n
    help
      Connect one authenticated Bluetooth LE boot-protocol keyboard alongside
      the phone. Adds a Keyboard screen in Settings > Keyboard. Keyboards must
      support LE Secure Connections with passkey entry; legacy and Just Works
      pairing are not supported. Adds a second Bluetooth connection slot.

config GH3X2X_TUNING_SERVICE_ENABLED
    bool "GH3X2X tuning service"
    depends on HRM_GH3X2X
    help
      Build the GH3X2X heart-rate sensor tuning GATT service, used to
      tune the sensor over BLE. Off by default.

endmenu
```
